# AVR128DA64S register map
Vendor: Atmel; File version: 1.0
CPU: other r0p0, little endian, no MPU, no FPU, 4 interrupt priority bits
Registers are 8-bit, read-write, reset 0x0 unless marked. A register's access mark holds for its fields unless they carry their own. Offsets are from the block's base; lines under a group give offsets from that group; [hi:lo] are bit positions; {n}, {i} and the like mark numbered series; 'fields as' and 'values as' point back to an identical list; <NAME> marks a mode.

## Memory map
0x00800000 VPORTA size 0x4 — Virtual Ports
0x00800004 VPORTB size 0x4 — Virtual Ports
0x00800008 VPORTC size 0x4 — Virtual Ports
0x0080000C VPORTD size 0x4 — Virtual Ports
0x00800010 VPORTE size 0x4 — Virtual Ports
0x00800014 VPORTF size 0x4 — Virtual Ports
0x00800018 VPORTG size 0x4 — Virtual Ports
0x0080001C GPR size 0x4 — General Purpose Registers
0x00800034 CPU blocks up to offset 0xC
0x00800040 RSTCTRL size 0x2 — Reset controller
0x00800050 SLPCTRL size 0x2 — Sleep Controller
0x00800060 CLKCTRL blocks up to offset 0x1D — Clock controller
0x00800080 BOD blocks up to offset 0xC — Bod interface
0x008000A0 VREF blocks up to offset 0x5 — Voltage reference
0x00800100 WDT size 0x2 — Watch-Dog Timer
0x00800110 CPUINT size 0x4 — Interrupt Controller
0x00800120 CRCSCAN size 0x3
0x00800140 RTC blocks up to offset 0x16 — Real-Time Counter
0x008001C0 CCL blocks up to offset 0x20 — Configurable Custom Logic
0x00800200 EVSYS blocks up to offset 0x4B — Event System
0x00800400 PORTA blocks up to offset 0x18 — I/O Ports
0x00800420 PORTB blocks up to offset 0x18 — I/O Ports
0x00800440 PORTC blocks up to offset 0x18 — I/O Ports
0x00800460 PORTD blocks up to offset 0x18 — I/O Ports
0x00800480 PORTE blocks up to offset 0x18 — I/O Ports
0x008004A0 PORTF blocks up to offset 0x18 — I/O Ports
0x008004C0 PORTG blocks up to offset 0x18 — I/O Ports
0x008005E0 PORTMUX size 0xB — Port Multiplexer
0x00800600 ADC0 blocks up to offset 0x16 — Analog to Digital Converter
0x00800680 AC0 blocks up to offset 0x8 — Analog Comparator
0x00800688 AC1 blocks up to offset 0x8 — Analog Comparator
0x00800690 AC2 blocks up to offset 0x8 — Analog Comparator
0x008006A0 DAC0 blocks up to offset 0x4 — Digital to Analog Converter
0x008006C0 ZCD0 blocks up to offset 0x4 — Zero Cross Detect
0x008006C8 ZCD1 blocks up to offset 0x4 — Zero Cross Detect
0x008006D0 ZCD2 blocks up to offset 0x4 — Zero Cross Detect
0x00800800 USART0 size 0xF — Universal Synchronous and Asynchronous Receiver and Transmitter
0x00800820 USART1 size 0xF — Universal Synchronous and Asynchronous Receiver and Transmitter
0x00800840 USART2 size 0xF — Universal Synchronous and Asynchronous Receiver and Transmitter
0x00800860 USART3 size 0xF — Universal Synchronous and Asynchronous Receiver and Transmitter
0x00800880 USART4 size 0xF — Universal Synchronous and Asynchronous Receiver and Transmitter
0x008008A0 USART5 size 0xF — Universal Synchronous and Asynchronous Receiver and Transmitter
0x00800900 TWI0 size 0xF — Two-Wire Interface
0x00800920 TWI1 size 0xF — Two-Wire Interface
0x00800940 SPI0 size 0x5 — Serial Peripheral Interface
0x00800960 SPI1 size 0x5 — Serial Peripheral Interface
0x00800A00 TCA0 blocks up to offset 0x3E — 16-bit Timer/Counter Type A
0x00800A40 TCA1 blocks up to offset 0x3E — 16-bit Timer/Counter Type A
0x00800B00 TCB0 blocks up to offset 0xE — 16-bit Timer Type B
0x00800B10 TCB1 blocks up to offset 0xE — 16-bit Timer Type B
0x00800B20 TCB2 blocks up to offset 0xE — 16-bit Timer Type B
0x00800B30 TCB3 blocks up to offset 0xE — 16-bit Timer Type B
0x00800B40 TCB4 blocks up to offset 0xE — 16-bit Timer Type B
0x00800B80 TCD0 blocks up to offset 0x30 — Timer Counter D
0x00800F01 SYSCFG blocks up to offset 0x19 — System Configuration Registers
0x00801000 NVMCTRL blocks up to offset 0xC — Non-volatile Memory Controller
0x00801040 LOCK size 0x4 — Lockbits
0x00801080 USERROW size 0x1
0x00801100 SIGROW blocks up to offset 0x20 — Signature row

## Interrupts
1 CRCSCAN_NMI (CPU)
2 BOD_VLM (CPU)
3 RTC_CNT (CPU)
4 RTC_PIT (CPU)
5 CCL_CCL (CPU)
6 PORTA_PORT (CPU)
7 TCA0_LUNF_OVF (CPU)
8 TCA0_HUNF (CPU)
9 TCA0_CMP0_LCMP0 (CPU)
10 TCA0_CMP1_LCMP1 (CPU)
11 TCA0_CMP2_LCMP2 (CPU)
12 TCB0_INT (CPU)
13 TCB1_INT (CPU)
14 TCD0_OVF (CPU)
15 TCD0_TRIG (CPU)
16 TWI0_TWIS (CPU)
17 TWI0_TWIM (CPU)
18 SPI0_INT (CPU)
19 USART0_RXC (CPU)
20 USART0_DRE (CPU)
21 USART0_TXC (CPU)
22 PORTD_PORT (CPU)
23 AC0_AC (CPU)
24 ADC0_RESRDY (CPU)
25 ADC0_WCMP (CPU)
26 ZCD0_ZCD (CPU)
27 PTC_PTC (CPU)
28 AC1_AC (CPU)
29 PORTC_PORT (CPU)
30 TCB2_INT (CPU)
31 USART1_RXC (CPU)
32 USART1_DRE (CPU)
33 USART1_TXC (CPU)
34 PORTF_PORT (CPU)
35 NVMCTRL_EE (CPU)
36 SPI1_INT (CPU)
37 USART2_RXC (CPU)
38 USART2_DRE (CPU)
39 USART2_TXC (CPU)
40 AC2_AC (CPU)
41 TCB3_INT (CPU)
42 TWI1_TWIS (CPU)
43 TWI1_TWIM (CPU)
44 PORTB_PORT (CPU)
45 PORTE_PORT (CPU)
46 TCA1_LUNF_OVF (CPU)
47 TCA1_HUNF (CPU)
48 TCA1_CMP0_LCMP0 (CPU)
49 TCA1_CMP1_LCMP1 (CPU)
50 TCA1_CMP2_LCMP2 (CPU)
51 ZCD1_ZCD (CPU)
52 USART3_RXC (CPU)
53 USART3_DRE (CPU)
54 USART3_TXC (CPU)
55 USART4_RXC (CPU)
56 USART4_DRE (CPU)
57 USART4_TXC (CPU)
58 PORTG_PORT (CPU)
59 ZCD2_ZCD (CPU)
60 TCB4_INT (CPU)
61 USART5_RXC (CPU)
62 USART5_DRE (CPU)
63 USART5_TXC (CPU)
