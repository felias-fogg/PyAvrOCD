# AVR128DA64S register map
Vendor: Atmel; File version: 1.0
CPU: other r0p0, little endian, no MPU, no FPU, 4 interrupt priority bits
Registers are 8-bit, read-write, reset 0x0 unless marked. A register's access mark holds for its fields unless they carry their own. Offsets are from the block's base; [hi:lo] are bit positions; {n}, {i} and the like mark numbered series; 'fields as' and 'values as' point back to an identical list.

## EVSYS — Event System
Base 0x00800200
0x00 SWEVENTA — Software Event A
  [7:0] SWEVENTA wo — Software event on channel select
    1=CH0 (Software event on channel 0); 2=CH1 (Software event on channel 1); 4=CH2 (Software event on channel 2); 8=CH3 (Software event on channel 3); 16=CH4 (Software event on channel 4); 32=CH5 (Software event on channel 5); 64=CH6 (Software event on channel 6); 128=CH7 (Software event on channel 7)
0x01 SWEVENTB — Software Event B
  [1:0] SWEVENTB wo — Software event on channel select
    1=CH8 (Software event on channel 8); 2=CH9 (Software event on channel 9)
0x10 CHANNEL0 — Multiplexer Channel 0
  [7:0] CHANNEL0 — Channel 0 generator select
    0=OFF; 1=UPDI_SYNCH (UPDI SYNCH character); 6=RTC_OVF (Real Time Counter overflow); 7=RTC_CMP (Real Time Counter compare); 8=RTC_PIT_DIV8192 (Periodic Interrupt Timer output 0); 9=RTC_PIT_DIV4096 (Periodic Interrupt Timer output 1); 10=RTC_PIT_DIV2048 (Periodic Interrupt Timer output 2); 11=RTC_PIT_DIV1024 (Periodic Interrupt Timer output 3); {v}=CCL_LUT{v-16} (Configurable Custom Logic LUT{v-16}) (v=16..21); 32=AC0_OUT (Analog Comparator 0 out); 33=AC1_OUT (Analog Comparator 1 out); 34=AC2_OUT (Analog Comparator 2 out); 36=ADC0_RESRDY (ADC 0 Result Ready); 40=PTC_RESRDY (PTC Result Ready); 48=ZCD0 (Zero Cross Detect 0 out); 49=ZCD1 (Zero Cross Detect 1 out); 50=ZCD2 (Zero Cross Detect 2 out); {v}=PORTA_PIN{v-64} (v=64..71); {v}=PORTB_PIN{v-72} (v=72..79); {v}=USART{v-96}_XCK (v=96..101); 104=SPI0_SCK; 105=SPI1_SCK; 128=TCA0_OVF_LUNF (Timer/Counter A0 overflow / low byte timer underflow); 129=TCA0_HUNF (Timer/Counter A0 high byte timer underflow); 132=TCA0_CMP0_LCMP0 (Timer/Counter A0 compare 0 / low byte timer compare 0); 133=TCA0_CMP1_LCMP1 (Timer/Counter A0 compare 1 / low byte timer compare 1); 134=TCA0_CMP2_LCMP2 (Timer/Counter A0 compare 2 / low byte timer compare 2); 136=TCA1_OVF_LUNF (Timer/Counter A1 overflow / low byte timer underflow); 137=TCA1_HUNF (Timer/Counter A1 high byte timer underflow); 140=TCA1_CMP0_LCMP0 (Timer/Counter A1 compare 0 / low byte timer compare 0); 141=TCA1_CMP1_LCMP1 (Timer/Counter A1 compare 1 / low byte timer compare 1); 142=TCA1_CMP2_LCMP2 (Timer/Counter A1 compare 2 / low byte timer compare 2); 160=TCB0_CAPT (Timer/Counter B0 capture); 161=TCB0_OVF (Timer/Counter B0 overflow); 162=TCB1_CAPT (Timer/Counter B1 capture); 163=TCB1_OVF (Timer/Counter B1 overflow); 164=TCB2_CAPT (Timer/Counter B2 capture); 165=TCB2_OVF (Timer/Counter B2 overflow); 166=TCB3_CAPT (Timer/Counter B3 capture); 167=TCB3_OVF (Timer/Counter B3 overflow); 168=TCB4_CAPT (Timer/Counter B4 capture); 169=TCB4_OVF (Timer/Counter B4 overflow); 176=TCD0_CMPBCLR (Timer/Counter D0 event 0); 177=TCD0_CMPASET (Timer/Counter D0 event 1); 178=TCD0_CMPBSET (Timer/Counter D0 event 2); 179=TCD0_PROGEV (Timer/Counter D0 event 3)
0x11 CHANNEL1 — Multiplexer Channel 1
  [7:0] CHANNEL1 — Channel 1 generator select
    0=OFF; 1=UPDI_SYNCH (UPDI SYNCH character); 6=RTC_OVF (Real Time Counter overflow); 7=RTC_CMP (Real Time Counter compare); 8=RTC_PIT_DIV512 (Periodic Interrupt Timer output 0); 9=RTC_PIT_DIV256 (Periodic Interrupt Timer output 1); 10=RTC_PIT_DIV128 (Periodic Interrupt Timer output 2); 11=RTC_PIT_DIV64 (Periodic Interrupt Timer output 3); {v}=CCL_LUT{v-16} (Configurable Custom Logic LUT{v-16}) (v=16..21); 32=AC0_OUT (Analog Comparator 0 out); 33=AC1_OUT (Analog Comparator 1 out); 34=AC2_OUT (Analog Comparator 2 out); 36=ADC0_RESRDY (ADC 0 Result Ready); 40=PTC_RESRDY (PTC Result Ready); 48=ZCD0 (Zero Cross Detect 0 out); 49=ZCD1 (Zero Cross Detect 1 out); 50=ZCD2 (Zero Cross Detect 2 out); {v}=PORTA_PIN{v-64} (v=64..71); {v}=PORTB_PIN{v-72} (v=72..79); {v}=USART{v-96}_XCK (v=96..101); 104=SPI0_SCK; 105=SPI1_SCK; 128=TCA0_OVF_LUNF (Timer/Counter A0 overflow / low byte timer underflow); 129=TCA0_HUNF (Timer/Counter A0 high byte timer underflow); 132=TCA0_CMP0_LCMP0 (Timer/Counter A0 compare 0 / low byte timer compare 0); 133=TCA0_CMP1_LCMP1 (Timer/Counter A0 compare 1 / low byte timer compare 1); 134=TCA0_CMP2_LCMP2 (Timer/Counter A0 compare 2 / low byte timer compare 2); 136=TCA1_OVF_LUNF (Timer/Counter A1 overflow / low byte timer underflow); 137=TCA1_HUNF (Timer/Counter A1 high byte timer underflow); 140=TCA1_CMP0_LCMP0 (Timer/Counter A1 compare 0 / low byte timer compare 0); 141=TCA1_CMP1_LCMP1 (Timer/Counter A1 compare 1 / low byte timer compare 1); 142=TCA1_CMP2_LCMP2 (Timer/Counter A1 compare 2 / low byte timer compare 2); 160=TCB0_CAPT (Timer/Counter B0 capture); 161=TCB0_OVF (Timer/Counter B0 overflow); 162=TCB1_CAPT (Timer/Counter B1 capture); 163=TCB1_OVF (Timer/Counter B1 overflow); 164=TCB2_CAPT (Timer/Counter B2 capture); 165=TCB2_OVF (Timer/Counter B2 overflow); 166=TCB3_CAPT (Timer/Counter B3 capture); 167=TCB3_OVF (Timer/Counter B3 overflow); 168=TCB4_CAPT (Timer/Counter B4 capture); 169=TCB4_OVF (Timer/Counter B4 overflow); 176=TCD0_CMPBCLR (Timer/Counter D0 event 0); 177=TCD0_CMPASET (Timer/Counter D0 event 1); 178=TCD0_CMPBSET (Timer/Counter D0 event 2); 179=TCD0_PROGEV (Timer/Counter D0 event 3)
0x12 CHANNEL2 — Multiplexer Channel 2
  [7:0] CHANNEL2 — Channel 2 generator select
    0=OFF; 1=UPDI_SYNCH (UPDI SYNCH character); 6=RTC_OVF (Real Time Counter overflow); 7=RTC_CMP (Real Time Counter compare); 8=RTC_PIT_DIV8192 (Periodic Interrupt Timer output 0); 9=RTC_PIT_DIV4096 (Periodic Interrupt Timer output 1); 10=RTC_PIT_DIV2048 (Periodic Interrupt Timer output 2); 11=RTC_PIT_DIV1024 (Periodic Interrupt Timer output 3); {v}=CCL_LUT{v-16} (Configurable Custom Logic LUT{v-16}) (v=16..21); 32=AC0_OUT (Analog Comparator 0 out); 33=AC1_OUT (Analog Comparator 1 out); 34=AC2_OUT (Analog Comparator 2 out); 36=ADC0_RESRDY (ADC 0 Result Ready); 40=PTC_RESRDY (PTC Result Ready); 48=ZCD0 (Zero Cross Detect 0 out); 49=ZCD1 (Zero Cross Detect 1 out); 50=ZCD2 (Zero Cross Detect 2 out); {v}=PORTC_PIN{v-64} (v=64..71); {v}=PORTD_PIN{v-72} (v=72..79); {v}=USART{v-96}_XCK (v=96..101); 104=SPI0_SCK; 105=SPI1_SCK; 128=TCA0_OVF_LUNF (Timer/Counter A0 overflow / low byte timer underflow); 129=TCA0_HUNF (Timer/Counter A0 high byte timer underflow); 132=TCA0_CMP0_LCMP0 (Timer/Counter A0 compare 0 / low byte timer compare 0); 133=TCA0_CMP1_LCMP1 (Timer/Counter A0 compare 1 / low byte timer compare 1); 134=TCA0_CMP2_LCMP2 (Timer/Counter A0 compare 2 / low byte timer compare 2); 136=TCA1_OVF_LUNF (Timer/Counter A1 overflow / low byte timer underflow); 137=TCA1_HUNF (Timer/Counter A1 high byte timer underflow); 140=TCA1_CMP0_LCMP0 (Timer/Counter A1 compare 0 / low byte timer compare 0); 141=TCA1_CMP1_LCMP1 (Timer/Counter A1 compare 1 / low byte timer compare 1); 142=TCA1_CMP2_LCMP2 (Timer/Counter A1 compare 2 / low byte timer compare 2); 160=TCB0_CAPT (Timer/Counter B0 capture); 161=TCB0_OVF (Timer/Counter B0 overflow); 162=TCB1_CAPT (Timer/Counter B1 capture); 163=TCB1_OVF (Timer/Counter B1 overflow); 164=TCB2_CAPT (Timer/Counter B2 capture); 165=TCB2_OVF (Timer/Counter B2 overflow); 166=TCB3_CAPT (Timer/Counter B3 capture); 167=TCB3_OVF (Timer/Counter B3 overflow); 168=TCB4_CAPT (Timer/Counter B4 capture); 169=TCB4_OVF (Timer/Counter B4 overflow); 176=TCD0_CMPBCLR (Timer/Counter D0 event 0); 177=TCD0_CMPASET (Timer/Counter D0 event 1); 178=TCD0_CMPBSET (Timer/Counter D0 event 2); 179=TCD0_PROGEV (Timer/Counter D0 event 3)
0x13 CHANNEL3 — Multiplexer Channel 3
  [7:0] CHANNEL3 — Channel 3 generator select
    0=OFF; 1=UPDI_SYNCH (UPDI SYNCH character); 6=RTC_OVF (Real Time Counter overflow); 7=RTC_CMP (Real Time Counter compare); 8=RTC_PIT_DIV512 (Periodic Interrupt Timer output 0); 9=RTC_PIT_DIV256 (Periodic Interrupt Timer output 1); 10=RTC_PIT_DIV128 (Periodic Interrupt Timer output 2); 11=RTC_PIT_DIV64 (Periodic Interrupt Timer output 3); {v}=CCL_LUT{v-16} (Configurable Custom Logic LUT{v-16}) (v=16..21); 32=AC0_OUT (Analog Comparator 0 out); 33=AC1_OUT (Analog Comparator 1 out); 34=AC2_OUT (Analog Comparator 2 out); 36=ADC0_RESRDY (ADC 0 Result Ready); 40=PTC_RESRDY (PTC Result Ready); 48=ZCD0 (Zero Cross Detect 0 out); 49=ZCD1 (Zero Cross Detect 1 out); 50=ZCD2 (Zero Cross Detect 2 out); {v}=PORTC_PIN{v-64} (v=64..71); {v}=PORTD_PIN{v-72} (v=72..79); {v}=USART{v-96}_XCK (v=96..101); 104=SPI0_SCK; 105=SPI1_SCK; 128=TCA0_OVF_LUNF (Timer/Counter A0 overflow / low byte timer underflow); 129=TCA0_HUNF (Timer/Counter A0 high byte timer underflow); 132=TCA0_CMP0_LCMP0 (Timer/Counter A0 compare 0 / low byte timer compare 0); 133=TCA0_CMP1_LCMP1 (Timer/Counter A0 compare 1 / low byte timer compare 1); 134=TCA0_CMP2_LCMP2 (Timer/Counter A0 compare 2 / low byte timer compare 2); 136=TCA1_OVF_LUNF (Timer/Counter A1 overflow / low byte timer underflow); 137=TCA1_HUNF (Timer/Counter A1 high byte timer underflow); 140=TCA1_CMP0_LCMP0 (Timer/Counter A1 compare 0 / low byte timer compare 0); 141=TCA1_CMP1_LCMP1 (Timer/Counter A1 compare 1 / low byte timer compare 1); 142=TCA1_CMP2_LCMP2 (Timer/Counter A1 compare 2 / low byte timer compare 2); 160=TCB0_CAPT (Timer/Counter B0 capture); 161=TCB0_OVF (Timer/Counter B0 overflow); 162=TCB1_CAPT (Timer/Counter B1 capture); 163=TCB1_OVF (Timer/Counter B1 overflow); 164=TCB2_CAPT (Timer/Counter B2 capture); 165=TCB2_OVF (Timer/Counter B2 overflow); 166=TCB3_CAPT (Timer/Counter B3 capture); 167=TCB3_OVF (Timer/Counter B3 overflow); 168=TCB4_CAPT (Timer/Counter B4 capture); 169=TCB4_OVF (Timer/Counter B4 overflow); 176=TCD0_CMPBCLR (Timer/Counter D0 event 0); 177=TCD0_CMPASET (Timer/Counter D0 event 1); 178=TCD0_CMPBSET (Timer/Counter D0 event 2); 179=TCD0_PROGEV (Timer/Counter D0 event 3)
0x14 CHANNEL4 — Multiplexer Channel 4
  [7:0] CHANNEL4 — Channel 4 generator select
    0=OFF; 1=UPDI_SYNCH (UPDI SYNCH character); 6=RTC_OVF (Real Time Counter overflow); 7=RTC_CMP (Real Time Counter compare); 8=RTC_PIT_DIV8192 (Periodic Interrupt Timer output 0); 9=RTC_PIT_DIV4096 (Periodic Interrupt Timer output 1); 10=RTC_PIT_DIV2048 (Periodic Interrupt Timer output 2); 11=RTC_PIT_DIV1024 (Periodic Interrupt Timer output 3); {v}=CCL_LUT{v-16} (Configurable Custom Logic LUT{v-16}) (v=16..21); 32=AC0_OUT (Analog Comparator 0 out); 33=AC1_OUT (Analog Comparator 1 out); 34=AC2_OUT (Analog Comparator 2 out); 36=ADC0_RESRDY (ADC 0 Result Ready); 40=PTC_RESRDY (PTC Result Ready); 48=ZCD0 (Zero Cross Detect 0 out); 49=ZCD1 (Zero Cross Detect 1 out); 50=ZCD2 (Zero Cross Detect 2 out); {v}=PORTE_PIN{v-64} (v=64..71); {v}=PORTF_PIN{v-72} (v=72..78); {v}=USART{v-96}_XCK (v=96..101); 104=SPI0_SCK; 105=SPI1_SCK; 128=TCA0_OVF_LUNF (Timer/Counter A0 overflow / low byte timer underflow); 129=TCA0_HUNF (Timer/Counter A0 high byte timer underflow); 132=TCA0_CMP0_LCMP0 (Timer/Counter A0 compare 0 / low byte timer compare 0); 133=TCA0_CMP1_LCMP1 (Timer/Counter A0 compare 1 / low byte timer compare 1); 134=TCA0_CMP2_LCMP2 (Timer/Counter A0 compare 2 / low byte timer compare 2); 136=TCA1_OVF_LUNF (Timer/Counter A1 overflow / low byte timer underflow); 137=TCA1_HUNF (Timer/Counter A1 high byte timer underflow); 140=TCA1_CMP0_LCMP0 (Timer/Counter A1 compare 0 / low byte timer compare 0); 141=TCA1_CMP1_LCMP1 (Timer/Counter A1 compare 1 / low byte timer compare 1); 142=TCA1_CMP2_LCMP2 (Timer/Counter A1 compare 2 / low byte timer compare 2); 160=TCB0_CAPT (Timer/Counter B0 capture); 161=TCB0_OVF (Timer/Counter B0 overflow); 162=TCB1_CAPT (Timer/Counter B1 capture); 163=TCB1_OVF (Timer/Counter B1 overflow); 164=TCB2_CAPT (Timer/Counter B2 capture); 165=TCB2_OVF (Timer/Counter B2 overflow); 166=TCB3_CAPT (Timer/Counter B3 capture); 167=TCB3_OVF (Timer/Counter B3 overflow); 168=TCB4_CAPT (Timer/Counter B4 capture); 169=TCB4_OVF (Timer/Counter B4 overflow); 176=TCD0_CMPBCLR (Timer/Counter D0 event 0); 177=TCD0_CMPASET (Timer/Counter D0 event 1); 178=TCD0_CMPBSET (Timer/Counter D0 event 2); 179=TCD0_PROGEV (Timer/Counter D0 event 3)
0x15 CHANNEL5 — Multiplexer Channel 5
  [7:0] CHANNEL5 — Channel 5 generator select
    0=OFF; 1=UPDI_SYNCH (UPDI SYNCH character); 6=RTC_OVF (Real Time Counter overflow); 7=RTC_CMP (Real Time Counter compare); 8=RTC_PIT_DIV512 (Periodic Interrupt Timer output 0); 9=RTC_PIT_DIV256 (Periodic Interrupt Timer output 1); 10=RTC_PIT_DIV128 (Periodic Interrupt Timer output 2); 11=RTC_PIT_DIV64 (Periodic Interrupt Timer output 3); {v}=CCL_LUT{v-16} (Configurable Custom Logic LUT{v-16}) (v=16..21); 32=AC0_OUT (Analog Comparator 0 out); 33=AC1_OUT (Analog Comparator 1 out); 34=AC2_OUT (Analog Comparator 2 out); 36=ADC0_RESRDY (ADC 0 Result Ready); 40=PTC_RESRDY (PTC Result Ready); 48=ZCD0 (Zero Cross Detect 0 out); 49=ZCD1 (Zero Cross Detect 1 out); 50=ZCD2 (Zero Cross Detect 2 out); {v}=PORTE_PIN{v-64} (v=64..71); {v}=PORTF_PIN{v-72} (v=72..78); {v}=USART{v-96}_XCK (v=96..101); 104=SPI0_SCK; 105=SPI1_SCK; 128=TCA0_OVF_LUNF (Timer/Counter A0 overflow / low byte timer underflow); 129=TCA0_HUNF (Timer/Counter A0 high byte timer underflow); 132=TCA0_CMP0_LCMP0 (Timer/Counter A0 compare 0 / low byte timer compare 0); 133=TCA0_CMP1_LCMP1 (Timer/Counter A0 compare 1 / low byte timer compare 1); 134=TCA0_CMP2_LCMP2 (Timer/Counter A0 compare 2 / low byte timer compare 2); 136=TCA1_OVF_LUNF (Timer/Counter A1 overflow / low byte timer underflow); 137=TCA1_HUNF (Timer/Counter A1 high byte timer underflow); 140=TCA1_CMP0_LCMP0 (Timer/Counter A1 compare 0 / low byte timer compare 0); 141=TCA1_CMP1_LCMP1 (Timer/Counter A1 compare 1 / low byte timer compare 1); 142=TCA1_CMP2_LCMP2 (Timer/Counter A1 compare 2 / low byte timer compare 2); 160=TCB0_CAPT (Timer/Counter B0 capture); 161=TCB0_OVF (Timer/Counter B0 overflow); 162=TCB1_CAPT (Timer/Counter B1 capture); 163=TCB1_OVF (Timer/Counter B1 overflow); 164=TCB2_CAPT (Timer/Counter B2 capture); 165=TCB2_OVF (Timer/Counter B2 overflow); 166=TCB3_CAPT (Timer/Counter B3 capture); 167=TCB3_OVF (Timer/Counter B3 overflow); 168=TCB4_CAPT (Timer/Counter B4 capture); 169=TCB4_OVF (Timer/Counter B4 overflow); 176=TCD0_CMPBCLR (Timer/Counter D0 event 0); 177=TCD0_CMPASET (Timer/Counter D0 event 1); 178=TCD0_CMPBSET (Timer/Counter D0 event 2); 179=TCD0_PROGEV (Timer/Counter D0 event 3)
0x16 CHANNEL6 — Multiplexer Channel 6
  [7:0] CHANNEL6 — Channel 6 generator select
    0=OFF; 1=UPDI_SYNCH (UPDI SYNCH character); 6=RTC_OVF (Real Time Counter overflow); 7=RTC_CMP (Real Time Counter compare); 8=RTC_PIT_DIV8192 (Periodic Interrupt Timer output 0); 9=RTC_PIT_DIV4096 (Periodic Interrupt Timer output 1); 10=RTC_PIT_DIV2048 (Periodic Interrupt Timer output 2); 11=RTC_PIT_DIV1024 (Periodic Interrupt Timer output 3); {v}=CCL_LUT{v-16} (Configurable Custom Logic LUT{v-16}) (v=16..21); 32=AC0_OUT (Analog Comparator 0 out); 33=AC1_OUT (Analog Comparator 1 out); 34=AC2_OUT (Analog Comparator 2 out); 36=ADC0_RESRDY (ADC 0 Result Ready); 40=PTC_RESRDY (PTC Result Ready); 48=ZCD0 (Zero Cross Detect 0 out); 49=ZCD1 (Zero Cross Detect 1 out); 50=ZCD2 (Zero Cross Detect 2 out); {v}=PORTG_PIN{v-64} (v=64..71); {v}=USART{v-96}_XCK (v=96..101); 104=SPI0_SCK; 105=SPI1_SCK; 128=TCA0_OVF_LUNF (Timer/Counter A0 overflow / low byte timer underflow); 129=TCA0_HUNF (Timer/Counter A0 high byte timer underflow); 132=TCA0_CMP0_LCMP0 (Timer/Counter A0 compare 0 / low byte timer compare 0); 133=TCA0_CMP1_LCMP1 (Timer/Counter A0 compare 1 / low byte timer compare 1); 134=TCA0_CMP2_LCMP2 (Timer/Counter A0 compare 2 / low byte timer compare 2); 136=TCA1_OVF_LUNF (Timer/Counter A1 overflow / low byte timer underflow); 137=TCA1_HUNF (Timer/Counter A1 high byte timer underflow); 140=TCA1_CMP0_LCMP0 (Timer/Counter A1 compare 0 / low byte timer compare 0); 141=TCA1_CMP1_LCMP1 (Timer/Counter A1 compare 1 / low byte timer compare 1); 142=TCA1_CMP2_LCMP2 (Timer/Counter A1 compare 2 / low byte timer compare 2); 160=TCB0_CAPT (Timer/Counter B0 capture); 161=TCB0_OVF (Timer/Counter B0 overflow); 162=TCB1_CAPT (Timer/Counter B1 capture); 163=TCB1_OVF (Timer/Counter B1 overflow); 164=TCB2_CAPT (Timer/Counter B2 capture); 165=TCB2_OVF (Timer/Counter B2 overflow); 166=TCB3_CAPT (Timer/Counter B3 capture); 167=TCB3_OVF (Timer/Counter B3 overflow); 168=TCB4_CAPT (Timer/Counter B4 capture); 169=TCB4_OVF (Timer/Counter B4 overflow); 176=TCD0_CMPBCLR (Timer/Counter D0 event 0); 177=TCD0_CMPASET (Timer/Counter D0 event 1); 178=TCD0_CMPBSET (Timer/Counter D0 event 2); 179=TCD0_PROGEV (Timer/Counter D0 event 3)
0x17 CHANNEL7 — Multiplexer Channel 7
  [7:0] CHANNEL7 — Channel 7 generator select
    0=OFF; 1=UPDI_SYNCH (UPDI SYNCH character); 6=RTC_OVF (Real Time Counter overflow); 7=RTC_CMP (Real Time Counter compare); 8=RTC_PIT_DIV512 (Periodic Interrupt Timer output 0); 9=RTC_PIT_DIV256 (Periodic Interrupt Timer output 1); 10=RTC_PIT_DIV128 (Periodic Interrupt Timer output 2); 11=RTC_PIT_DIV64 (Periodic Interrupt Timer output 3); {v}=CCL_LUT{v-16} (Configurable Custom Logic LUT{v-16}) (v=16..21); 32=AC0_OUT (Analog Comparator 0 out); 33=AC1_OUT (Analog Comparator 1 out); 34=AC2_OUT (Analog Comparator 2 out); 36=ADC0_RESRDY (ADC 0 Result Ready); 40=PTC_RESRDY (PTC Result Ready); 48=ZCD0 (Zero Cross Detect 0 out); 49=ZCD1 (Zero Cross Detect 1 out); 50=ZCD2 (Zero Cross Detect 2 out); {v}=PORTG_PIN{v-64} (v=64..71); {v}=USART{v-96}_XCK (v=96..101); 104=SPI0_SCK; 105=SPI1_SCK; 128=TCA0_OVF_LUNF (Timer/Counter A0 overflow / low byte timer underflow); 129=TCA0_HUNF (Timer/Counter A0 high byte timer underflow); 132=TCA0_CMP0_LCMP0 (Timer/Counter A0 compare 0 / low byte timer compare 0); 133=TCA0_CMP1_LCMP1 (Timer/Counter A0 compare 1 / low byte timer compare 1); 134=TCA0_CMP2_LCMP2 (Timer/Counter A0 compare 2 / low byte timer compare 2); 136=TCA1_OVF_LUNF (Timer/Counter A1 overflow / low byte timer underflow); 137=TCA1_HUNF (Timer/Counter A1 high byte timer underflow); 140=TCA1_CMP0_LCMP0 (Timer/Counter A1 compare 0 / low byte timer compare 0); 141=TCA1_CMP1_LCMP1 (Timer/Counter A1 compare 1 / low byte timer compare 1); 142=TCA1_CMP2_LCMP2 (Timer/Counter A1 compare 2 / low byte timer compare 2); 160=TCB0_CAPT (Timer/Counter B0 capture); 161=TCB0_OVF (Timer/Counter B0 overflow); 162=TCB1_CAPT (Timer/Counter B1 capture); 163=TCB1_OVF (Timer/Counter B1 overflow); 164=TCB2_CAPT (Timer/Counter B2 capture); 165=TCB2_OVF (Timer/Counter B2 overflow); 166=TCB3_CAPT (Timer/Counter B3 capture); 167=TCB3_OVF (Timer/Counter B3 overflow); 168=TCB4_CAPT (Timer/Counter B4 capture); 169=TCB4_OVF (Timer/Counter B4 overflow); 176=TCD0_CMPBCLR (Timer/Counter D0 event 0); 177=TCD0_CMPASET (Timer/Counter D0 event 1); 178=TCD0_CMPBSET (Timer/Counter D0 event 2); 179=TCD0_PROGEV (Timer/Counter D0 event 3)
0x18 CHANNEL8 — Multiplexer Channel 8
  [7:0] CHANNEL8 — Channel 8 generator select
    0=OFF; 1=UPDI_SYNCH (UPDI SYNCH character); 6=RTC_OVF (Real Time Counter overflow); 7=RTC_CMP (Real Time Counter compare); 8=RTC_PIT_DIV8192 (Periodic Interrupt Timer output 0); 9=RTC_PIT_DIV4096 (Periodic Interrupt Timer output 1); 10=RTC_PIT_DIV2048 (Periodic Interrupt Timer output 2); 11=RTC_PIT_DIV1024 (Periodic Interrupt Timer output 3); {v}=CCL_LUT{v-16} (Configurable Custom Logic LUT{v-16}) (v=16..21); 32=AC0_OUT (Analog Comparator 0 out); 33=AC1_OUT (Analog Comparator 1 out); 34=AC2_OUT (Analog Comparator 2 out); 36=ADC0_RESRDY (ADC 0 Result Ready); 40=PTC_RESRDY (PTC Result Ready); 48=ZCD0 (Zero Cross Detect 0 out); 49=ZCD1 (Zero Cross Detect 1 out); 50=ZCD2 (Zero Cross Detect 2 out); {v}=USART{v-96}_XCK (v=96..101); 104=SPI0_SCK; 105=SPI1_SCK; 128=TCA0_OVF_LUNF (Timer/Counter A0 overflow / low byte timer underflow); 129=TCA0_HUNF (Timer/Counter A0 high byte timer underflow); 132=TCA0_CMP0_LCMP0 (Timer/Counter A0 compare 0 / low byte timer compare 0); 133=TCA0_CMP1_LCMP1 (Timer/Counter A0 compare 1 / low byte timer compare 1); 134=TCA0_CMP2_LCMP2 (Timer/Counter A0 compare 2 / low byte timer compare 2); 136=TCA1_OVF_LUNF (Timer/Counter A1 overflow / low byte timer underflow); 137=TCA1_HUNF (Timer/Counter A1 high byte timer underflow); 140=TCA1_CMP0_LCMP0 (Timer/Counter A1 compare 0 / low byte timer compare 0); 141=TCA1_CMP1_LCMP1 (Timer/Counter A1 compare 1 / low byte timer compare 1); 142=TCA1_CMP2_LCMP2 (Timer/Counter A1 compare 2 / low byte timer compare 2); 160=TCB0_CAPT (Timer/Counter B0 capture); 161=TCB0_OVF (Timer/Counter B0 overflow); 162=TCB1_CAPT (Timer/Counter B1 capture); 163=TCB1_OVF (Timer/Counter B1 overflow); 164=TCB2_CAPT (Timer/Counter B2 capture); 165=TCB2_OVF (Timer/Counter B2 overflow); 166=TCB3_CAPT (Timer/Counter B3 capture); 167=TCB3_OVF (Timer/Counter B3 overflow); 168=TCB4_CAPT (Timer/Counter B4 capture); 169=TCB4_OVF (Timer/Counter B4 overflow); 176=TCD0_CMPBCLR (Timer/Counter D0 event 0); 177=TCD0_CMPASET (Timer/Counter D0 event 1); 178=TCD0_CMPBSET (Timer/Counter D0 event 2); 179=TCD0_PROGEV (Timer/Counter D0 event 3)
0x19 CHANNEL9 — Multiplexer Channel 9
  [7:0] CHANNEL9 — Channel 9 generator select
    0=OFF; 1=UPDI_SYNCH (UPDI SYNCH character); 6=RTC_OVF (Real Time Counter overflow); 7=RTC_CMP (Real Time Counter compare); 8=RTC_PIT_DIV512 (Periodic Interrupt Timer output 0); 9=RTC_PIT_DIV256 (Periodic Interrupt Timer output 1); 10=RTC_PIT_DIV128 (Periodic Interrupt Timer output 2); 11=RTC_PIT_DIV64 (Periodic Interrupt Timer output 3); {v}=CCL_LUT{v-16} (Configurable Custom Logic LUT{v-16}) (v=16..21); 32=AC0_OUT (Analog Comparator 0 out); 33=AC1_OUT (Analog Comparator 1 out); 34=AC2_OUT (Analog Comparator 2 out); 36=ADC0_RESRDY (ADC 0 Result Ready); 40=PTC_RESRDY (PTC Result Ready); 48=ZCD0 (Zero Cross Detect 0 out); 49=ZCD1 (Zero Cross Detect 1 out); 50=ZCD2 (Zero Cross Detect 2 out); {v}=USART{v-96}_XCK (v=96..101); 104=SPI0_SCK; 105=SPI1_SCK; 128=TCA0_OVF_LUNF (Timer/Counter A0 overflow / low byte timer underflow); 129=TCA0_HUNF (Timer/Counter A0 high byte timer underflow); 132=TCA0_CMP0_LCMP0 (Timer/Counter A0 compare 0 / low byte timer compare 0); 133=TCA0_CMP1_LCMP1 (Timer/Counter A0 compare 1 / low byte timer compare 1); 134=TCA0_CMP2_LCMP2 (Timer/Counter A0 compare 2 / low byte timer compare 2); 136=TCA1_OVF_LUNF (Timer/Counter A1 overflow / low byte timer underflow); 137=TCA1_HUNF (Timer/Counter A1 high byte timer underflow); 140=TCA1_CMP0_LCMP0 (Timer/Counter A1 compare 0 / low byte timer compare 0); 141=TCA1_CMP1_LCMP1 (Timer/Counter A1 compare 1 / low byte timer compare 1); 142=TCA1_CMP2_LCMP2 (Timer/Counter A1 compare 2 / low byte timer compare 2); 160=TCB0_CAPT (Timer/Counter B0 capture); 161=TCB0_OVF (Timer/Counter B0 overflow); 162=TCB1_CAPT (Timer/Counter B1 capture); 163=TCB1_OVF (Timer/Counter B1 overflow); 164=TCB2_CAPT (Timer/Counter B2 capture); 165=TCB2_OVF (Timer/Counter B2 overflow); 166=TCB3_CAPT (Timer/Counter B3 capture); 167=TCB3_OVF (Timer/Counter B3 overflow); 168=TCB4_CAPT (Timer/Counter B4 capture); 169=TCB4_OVF (Timer/Counter B4 overflow); 176=TCD0_CMPBCLR (Timer/Counter D0 event 0); 177=TCD0_CMPASET (Timer/Counter D0 event 1); 178=TCD0_CMPBSET (Timer/Counter D0 event 2); 179=TCD0_PROGEV (Timer/Counter D0 event 3)
{0x20+2i} USERCCLLUT{i}A (i=0..5) — User {2i} - CCL{i} Event A
  [7:0] USER — User channel select
    0=OFF (Off, No Eventsys Channel connected); {v}=CHANNEL{v-1} (Connect user to event channel {v-1}) (v=1..10)
{0x21+2i} USERCCLLUT{i}B (i=0..5) — User {2i+1} - CCL{i} Event B
  fields as USERCCLLUT0A
0x2C USERADC0START — User 12 - ADC0
  fields as USERCCLLUT0A
0x2D USERPTCSTART — User 13 - PTC
  fields as USERCCLLUT0A
0x2E USEREVSYSEVOUTA — User 14 - EVOUTA
  fields as USERCCLLUT0A
0x2F USEREVSYSEVOUTB — User 15 - EVOUTB
  fields as USERCCLLUT0A
0x30 USEREVSYSEVOUTC — User 16 - EVOUTC
  fields as USERCCLLUT0A
0x31 USEREVSYSEVOUTD — User 17 - EVOUTD
  fields as USERCCLLUT0A
0x32 USEREVSYSEVOUTE — User 18 - EVOUTE
  fields as USERCCLLUT0A
0x33 USEREVSYSEVOUTF — User 19 - EVOUTF
  fields as USERCCLLUT0A
0x34 USEREVSYSEVOUTG — User 20 - EVOUTG
  fields as USERCCLLUT0A
{0x35+i} USERUSART{i}IRDA (i=0..5) — User {i+21} - USART{i}
  fields as USERCCLLUT0A
0x3B USERTCA0CNTA — User 27 - TCA0 Event A
  fields as USERCCLLUT0A
0x3C USERTCA0CNTB — User 28 - TCA0 Event B
  fields as USERCCLLUT0A
0x3D USERTCA1CNTA — User 29 - TCA1 Event A
  fields as USERCCLLUT0A
0x3E USERTCA1CNTB — User 30 - TCA1 Event B
  fields as USERCCLLUT0A
{0x3F+2i} USERTCB{i}CAPT (i=0..4) — User {2i+31} - TCB{i} Event A
  fields as USERCCLLUT0A
{0x40+2i} USERTCB{i}COUNT (i=0..4) — User {2i+32} - TCB{i} Event B
  fields as USERCCLLUT0A
0x49 USERTCD0INPUTA — User 41 - TCD0 Event A
  fields as USERCCLLUT0A
0x4A USERTCD0INPUTB — User 42 - TCD0 Event B
  fields as USERCCLLUT0A
