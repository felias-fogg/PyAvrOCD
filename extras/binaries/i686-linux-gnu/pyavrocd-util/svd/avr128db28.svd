# AVR128DB28 register map
Vendor: Atmel; File version: 1.0
CPU: other r0p0, little endian, no MPU, no FPU, 4 interrupt priority bits
Registers are 8-bit, read-write, reset 0x0 unless marked. A register's access mark holds for its fields unless they carry their own. Offsets are from the block's base; [hi:lo] are bit positions; {n}, {i} and the like mark numbered series; 'fields as' and 'values as' point back to an identical list.

## EVSYS — Event System
Base 0x00800200
0x00 SWEVENTA — Software Event A
  [7:0] SWEVENTA wo — Software event on channel select
    1=CH0 (Software event on channel 0); 2=CH1 (Software event on channel 1); 4=CH2 (Software event on channel 2); 8=CH3 (Software event on channel 3); 16=CH4 (Software event on channel 4); 32=CH5 (Software event on channel 5); 64=CH6 (Software event on channel 6); 128=CH7 (Software event on channel 7)
0x10 CHANNEL0 — Multiplexer Channel 0
  [7:0] CHANNEL0 — Channel 0 generator select
    0=OFF; 1=UPDI_SYNCH (UPDI SYNCH character); 5=MVIO (MVIO VDDIO2 OK); 6=RTC_OVF (Real Time Counter overflow); 7=RTC_CMP (Real Time Counter compare); 8=RTC_PIT_DIV8192 (Periodic Interrupt Timer output 0); 9=RTC_PIT_DIV4096 (Periodic Interrupt Timer output 1); 10=RTC_PIT_DIV2048 (Periodic Interrupt Timer output 2); 11=RTC_PIT_DIV1024 (Periodic Interrupt Timer output 3); {v}=CCL_LUT{v-16} (Configurable Custom Logic LUT{v-16}) (v=16..19); 32=AC0_OUT (Analog Comparator 0 out); 33=AC1_OUT (Analog Comparator 1 out); 34=AC2_OUT (Analog Comparator 2 out); 36=ADC0_RESRDY (ADC 0 Result Ready); 48=ZCD0 (Zero Cross Detect 0 out); 52=OPAMP0_READY; 53=OPAMP1_READY; {v}=PORTA_PIN{v-64} (v=64..71); 96=USART0_XCK; 97=USART1_XCK; 98=USART2_XCK; 104=SPI0_SCK; 105=SPI1_SCK; 128=TCA0_OVF_LUNF (Timer/Counter A0 overflow / low byte timer underflow); 129=TCA0_HUNF (Timer/Counter A0 high byte timer underflow); 132=TCA0_CMP0_LCMP0 (Timer/Counter A0 compare 0 / low byte timer compare 0); 133=TCA0_CMP1_LCMP1 (Timer/Counter A0 compare 1 / low byte timer compare 1); 134=TCA0_CMP2_LCMP2 (Timer/Counter A0 compare 2 / low byte timer compare 2); 160=TCB0_CAPT (Timer/Counter B0 capture); 161=TCB0_OVF (Timer/Counter B0 overflow); 162=TCB1_CAPT (Timer/Counter B1 capture); 163=TCB1_OVF (Timer/Counter B1 overflow); 164=TCB2_CAPT (Timer/Counter B2 capture); 165=TCB2_OVF (Timer/Counter B2 overflow); 176=TCD0_CMPBCLR (Timer/Counter D0 event 0); 177=TCD0_CMPASET (Timer/Counter D0 event 1); 178=TCD0_CMPBSET (Timer/Counter D0 event 2); 179=TCD0_PROGEV (Timer/Counter D0 event 3)
0x11 CHANNEL1 — Multiplexer Channel 1
  [7:0] CHANNEL1 — Channel 1 generator select
    0=OFF; 1=UPDI_SYNCH (UPDI SYNCH character); 5=MVIO (MVIO VDDIO2 OK); 6=RTC_OVF (Real Time Counter overflow); 7=RTC_CMP (Real Time Counter compare); 8=RTC_PIT_DIV512 (Periodic Interrupt Timer output 0); 9=RTC_PIT_DIV256 (Periodic Interrupt Timer output 1); 10=RTC_PIT_DIV128 (Periodic Interrupt Timer output 2); 11=RTC_PIT_DIV64 (Periodic Interrupt Timer output 3); {v}=CCL_LUT{v-16} (Configurable Custom Logic LUT{v-16}) (v=16..19); 32=AC0_OUT (Analog Comparator 0 out); 33=AC1_OUT (Analog Comparator 1 out); 34=AC2_OUT (Analog Comparator 2 out); 36=ADC0_RESRDY (ADC 0 Result Ready); 48=ZCD0 (Zero Cross Detect 0 out); 52=OPAMP0_READY; 53=OPAMP1_READY; {v}=PORTA_PIN{v-64} (v=64..71); 96=USART0_XCK; 97=USART1_XCK; 98=USART2_XCK; 104=SPI0_SCK; 105=SPI1_SCK; 128=TCA0_OVF_LUNF (Timer/Counter A0 overflow / low byte timer underflow); 129=TCA0_HUNF (Timer/Counter A0 high byte timer underflow); 132=TCA0_CMP0_LCMP0 (Timer/Counter A0 compare 0 / low byte timer compare 0); 133=TCA0_CMP1_LCMP1 (Timer/Counter A0 compare 1 / low byte timer compare 1); 134=TCA0_CMP2_LCMP2 (Timer/Counter A0 compare 2 / low byte timer compare 2); 160=TCB0_CAPT (Timer/Counter B0 capture); 161=TCB0_OVF (Timer/Counter B0 overflow); 162=TCB1_CAPT (Timer/Counter B1 capture); 163=TCB1_OVF (Timer/Counter B1 overflow); 164=TCB2_CAPT (Timer/Counter B2 capture); 165=TCB2_OVF (Timer/Counter B2 overflow); 176=TCD0_CMPBCLR (Timer/Counter D0 event 0); 177=TCD0_CMPASET (Timer/Counter D0 event 1); 178=TCD0_CMPBSET (Timer/Counter D0 event 2); 179=TCD0_PROGEV (Timer/Counter D0 event 3)
0x12 CHANNEL2 — Multiplexer Channel 2
  [7:0] CHANNEL2 — Channel 2 generator select
    0=OFF; 1=UPDI_SYNCH (UPDI SYNCH character); 5=MVIO (MVIO VDDIO2 OK); 6=RTC_OVF (Real Time Counter overflow); 7=RTC_CMP (Real Time Counter compare); 8=RTC_PIT_DIV8192 (Periodic Interrupt Timer output 0); 9=RTC_PIT_DIV4096 (Periodic Interrupt Timer output 1); 10=RTC_PIT_DIV2048 (Periodic Interrupt Timer output 2); 11=RTC_PIT_DIV1024 (Periodic Interrupt Timer output 3); {v}=CCL_LUT{v-16} (Configurable Custom Logic LUT{v-16}) (v=16..19); 32=AC0_OUT (Analog Comparator 0 out); 33=AC1_OUT (Analog Comparator 1 out); 34=AC2_OUT (Analog Comparator 2 out); 36=ADC0_RESRDY (ADC 0 Result Ready); 48=ZCD0 (Zero Cross Detect 0 out); 52=OPAMP0_READY; 53=OPAMP1_READY; {v}=PORTC_PIN{v-64} (v=64..67); {v}=PORTD_PIN{v-72} (v=73..79); 96=USART0_XCK; 97=USART1_XCK; 98=USART2_XCK; 104=SPI0_SCK; 105=SPI1_SCK; 128=TCA0_OVF_LUNF (Timer/Counter A0 overflow / low byte timer underflow); 129=TCA0_HUNF (Timer/Counter A0 high byte timer underflow); 132=TCA0_CMP0_LCMP0 (Timer/Counter A0 compare 0 / low byte timer compare 0); 133=TCA0_CMP1_LCMP1 (Timer/Counter A0 compare 1 / low byte timer compare 1); 134=TCA0_CMP2_LCMP2 (Timer/Counter A0 compare 2 / low byte timer compare 2); 160=TCB0_CAPT (Timer/Counter B0 capture); 161=TCB0_OVF (Timer/Counter B0 overflow); 162=TCB1_CAPT (Timer/Counter B1 capture); 163=TCB1_OVF (Timer/Counter B1 overflow); 164=TCB2_CAPT (Timer/Counter B2 capture); 165=TCB2_OVF (Timer/Counter B2 overflow); 176=TCD0_CMPBCLR (Timer/Counter D0 event 0); 177=TCD0_CMPASET (Timer/Counter D0 event 1); 178=TCD0_CMPBSET (Timer/Counter D0 event 2); 179=TCD0_PROGEV (Timer/Counter D0 event 3)
0x13 CHANNEL3 — Multiplexer Channel 3
  [7:0] CHANNEL3 — Channel 3 generator select
    0=OFF; 1=UPDI_SYNCH (UPDI SYNCH character); 5=MVIO (MVIO VDDIO2 OK); 6=RTC_OVF (Real Time Counter overflow); 7=RTC_CMP (Real Time Counter compare); 8=RTC_PIT_DIV512 (Periodic Interrupt Timer output 0); 9=RTC_PIT_DIV256 (Periodic Interrupt Timer output 1); 10=RTC_PIT_DIV128 (Periodic Interrupt Timer output 2); 11=RTC_PIT_DIV64 (Periodic Interrupt Timer output 3); {v}=CCL_LUT{v-16} (Configurable Custom Logic LUT{v-16}) (v=16..19); 32=AC0_OUT (Analog Comparator 0 out); 33=AC1_OUT (Analog Comparator 1 out); 34=AC2_OUT (Analog Comparator 2 out); 36=ADC0_RESRDY (ADC 0 Result Ready); 48=ZCD0 (Zero Cross Detect 0 out); 52=OPAMP0_READY; 53=OPAMP1_READY; {v}=PORTC_PIN{v-64} (v=64..67); {v}=PORTD_PIN{v-72} (v=73..79); 96=USART0_XCK; 97=USART1_XCK; 98=USART2_XCK; 104=SPI0_SCK; 105=SPI1_SCK; 128=TCA0_OVF_LUNF (Timer/Counter A0 overflow / low byte timer underflow); 129=TCA0_HUNF (Timer/Counter A0 high byte timer underflow); 132=TCA0_CMP0_LCMP0 (Timer/Counter A0 compare 0 / low byte timer compare 0); 133=TCA0_CMP1_LCMP1 (Timer/Counter A0 compare 1 / low byte timer compare 1); 134=TCA0_CMP2_LCMP2 (Timer/Counter A0 compare 2 / low byte timer compare 2); 160=TCB0_CAPT (Timer/Counter B0 capture); 161=TCB0_OVF (Timer/Counter B0 overflow); 162=TCB1_CAPT (Timer/Counter B1 capture); 163=TCB1_OVF (Timer/Counter B1 overflow); 164=TCB2_CAPT (Timer/Counter B2 capture); 165=TCB2_OVF (Timer/Counter B2 overflow); 176=TCD0_CMPBCLR (Timer/Counter D0 event 0); 177=TCD0_CMPASET (Timer/Counter D0 event 1); 178=TCD0_CMPBSET (Timer/Counter D0 event 2); 179=TCD0_PROGEV (Timer/Counter D0 event 3)
0x14 CHANNEL4 — Multiplexer Channel 4
  [7:0] CHANNEL4 — Channel 4 generator select
    0=OFF; 1=UPDI_SYNCH (UPDI SYNCH character); 5=MVIO (MVIO VDDIO2 OK); 6=RTC_OVF (Real Time Counter overflow); 7=RTC_CMP (Real Time Counter compare); 8=RTC_PIT_DIV8192 (Periodic Interrupt Timer output 0); 9=RTC_PIT_DIV4096 (Periodic Interrupt Timer output 1); 10=RTC_PIT_DIV2048 (Periodic Interrupt Timer output 2); 11=RTC_PIT_DIV1024 (Periodic Interrupt Timer output 3); {v}=CCL_LUT{v-16} (Configurable Custom Logic LUT{v-16}) (v=16..19); 32=AC0_OUT (Analog Comparator 0 out); 33=AC1_OUT (Analog Comparator 1 out); 34=AC2_OUT (Analog Comparator 2 out); 36=ADC0_RESRDY (ADC 0 Result Ready); 48=ZCD0 (Zero Cross Detect 0 out); 52=OPAMP0_READY; 53=OPAMP1_READY; 72=PORTF_PIN0; 73=PORTF_PIN1; 78=PORTF_PIN6; 96=USART0_XCK; 97=USART1_XCK; 98=USART2_XCK; 104=SPI0_SCK; 105=SPI1_SCK; 128=TCA0_OVF_LUNF (Timer/Counter A0 overflow / low byte timer underflow); 129=TCA0_HUNF (Timer/Counter A0 high byte timer underflow); 132=TCA0_CMP0_LCMP0 (Timer/Counter A0 compare 0 / low byte timer compare 0); 133=TCA0_CMP1_LCMP1 (Timer/Counter A0 compare 1 / low byte timer compare 1); 134=TCA0_CMP2_LCMP2 (Timer/Counter A0 compare 2 / low byte timer compare 2); 160=TCB0_CAPT (Timer/Counter B0 capture); 161=TCB0_OVF (Timer/Counter B0 overflow); 162=TCB1_CAPT (Timer/Counter B1 capture); 163=TCB1_OVF (Timer/Counter B1 overflow); 164=TCB2_CAPT (Timer/Counter B2 capture); 165=TCB2_OVF (Timer/Counter B2 overflow); 176=TCD0_CMPBCLR (Timer/Counter D0 event 0); 177=TCD0_CMPASET (Timer/Counter D0 event 1); 178=TCD0_CMPBSET (Timer/Counter D0 event 2); 179=TCD0_PROGEV (Timer/Counter D0 event 3)
0x15 CHANNEL5 — Multiplexer Channel 5
  [7:0] CHANNEL5 — Channel 5 generator select
    0=OFF; 1=UPDI_SYNCH (UPDI SYNCH character); 5=MVIO (MVIO VDDIO2 OK); 6=RTC_OVF (Real Time Counter overflow); 7=RTC_CMP (Real Time Counter compare); 8=RTC_PIT_DIV512 (Periodic Interrupt Timer output 0); 9=RTC_PIT_DIV256 (Periodic Interrupt Timer output 1); 10=RTC_PIT_DIV128 (Periodic Interrupt Timer output 2); 11=RTC_PIT_DIV64 (Periodic Interrupt Timer output 3); {v}=CCL_LUT{v-16} (Configurable Custom Logic LUT{v-16}) (v=16..19); 32=AC0_OUT (Analog Comparator 0 out); 33=AC1_OUT (Analog Comparator 1 out); 34=AC2_OUT (Analog Comparator 2 out); 36=ADC0_RESRDY (ADC 0 Result Ready); 48=ZCD0 (Zero Cross Detect 0 out); 52=OPAMP0_READY; 53=OPAMP1_READY; 72=PORTF_PIN0; 73=PORTF_PIN1; 78=PORTF_PIN6; 96=USART0_XCK; 97=USART1_XCK; 98=USART2_XCK; 104=SPI0_SCK; 105=SPI1_SCK; 128=TCA0_OVF_LUNF (Timer/Counter A0 overflow / low byte timer underflow); 129=TCA0_HUNF (Timer/Counter A0 high byte timer underflow); 132=TCA0_CMP0_LCMP0 (Timer/Counter A0 compare 0 / low byte timer compare 0); 133=TCA0_CMP1_LCMP1 (Timer/Counter A0 compare 1 / low byte timer compare 1); 134=TCA0_CMP2_LCMP2 (Timer/Counter A0 compare 2 / low byte timer compare 2); 160=TCB0_CAPT (Timer/Counter B0 capture); 161=TCB0_OVF (Timer/Counter B0 overflow); 162=TCB1_CAPT (Timer/Counter B1 capture); 163=TCB1_OVF (Timer/Counter B1 overflow); 164=TCB2_CAPT (Timer/Counter B2 capture); 165=TCB2_OVF (Timer/Counter B2 overflow); 176=TCD0_CMPBCLR (Timer/Counter D0 event 0); 177=TCD0_CMPASET (Timer/Counter D0 event 1); 178=TCD0_CMPBSET (Timer/Counter D0 event 2); 179=TCD0_PROGEV (Timer/Counter D0 event 3)
0x16 CHANNEL6 — Multiplexer Channel 6
  [7:0] CHANNEL6 — Channel 6 generator select
    0=OFF; 1=UPDI_SYNCH (UPDI SYNCH character); 5=MVIO (MVIO VDDIO2 OK); 6=RTC_OVF (Real Time Counter overflow); 7=RTC_CMP (Real Time Counter compare); 8=RTC_PIT_DIV8192 (Periodic Interrupt Timer output 0); 9=RTC_PIT_DIV4096 (Periodic Interrupt Timer output 1); 10=RTC_PIT_DIV2048 (Periodic Interrupt Timer output 2); 11=RTC_PIT_DIV1024 (Periodic Interrupt Timer output 3); {v}=CCL_LUT{v-16} (Configurable Custom Logic LUT{v-16}) (v=16..19); 32=AC0_OUT (Analog Comparator 0 out); 33=AC1_OUT (Analog Comparator 1 out); 34=AC2_OUT (Analog Comparator 2 out); 36=ADC0_RESRDY (ADC 0 Result Ready); 48=ZCD0 (Zero Cross Detect 0 out); 52=OPAMP0_READY; 53=OPAMP1_READY; 96=USART0_XCK; 97=USART1_XCK; 98=USART2_XCK; 104=SPI0_SCK; 105=SPI1_SCK; 128=TCA0_OVF_LUNF (Timer/Counter A0 overflow / low byte timer underflow); 129=TCA0_HUNF (Timer/Counter A0 high byte timer underflow); 132=TCA0_CMP0_LCMP0 (Timer/Counter A0 compare 0 / low byte timer compare 0); 133=TCA0_CMP1_LCMP1 (Timer/Counter A0 compare 1 / low byte timer compare 1); 134=TCA0_CMP2_LCMP2 (Timer/Counter A0 compare 2 / low byte timer compare 2); 160=TCB0_CAPT (Timer/Counter B0 capture); 161=TCB0_OVF (Timer/Counter B0 overflow); 162=TCB1_CAPT (Timer/Counter B1 capture); 163=TCB1_OVF (Timer/Counter B1 overflow); 164=TCB2_CAPT (Timer/Counter B2 capture); 165=TCB2_OVF (Timer/Counter B2 overflow); 176=TCD0_CMPBCLR (Timer/Counter D0 event 0); 177=TCD0_CMPASET (Timer/Counter D0 event 1); 178=TCD0_CMPBSET (Timer/Counter D0 event 2); 179=TCD0_PROGEV (Timer/Counter D0 event 3)
0x17 CHANNEL7 — Multiplexer Channel 7
  [7:0] CHANNEL7 — Channel 7 generator select
    0=OFF; 1=UPDI_SYNCH (UPDI SYNCH character); 5=MVIO (MVIO VDDIO2 OK); 6=RTC_OVF (Real Time Counter overflow); 7=RTC_CMP (Real Time Counter compare); 8=RTC_PIT_DIV512 (Periodic Interrupt Timer output 0); 9=RTC_PIT_DIV256 (Periodic Interrupt Timer output 1); 10=RTC_PIT_DIV128 (Periodic Interrupt Timer output 2); 11=RTC_PIT_DIV64 (Periodic Interrupt Timer output 3); {v}=CCL_LUT{v-16} (Configurable Custom Logic LUT{v-16}) (v=16..19); 32=AC0_OUT (Analog Comparator 0 out); 33=AC1_OUT (Analog Comparator 1 out); 34=AC2_OUT (Analog Comparator 2 out); 36=ADC0_RESRDY (ADC 0 Result Ready); 48=ZCD0 (Zero Cross Detect 0 out); 52=OPAMP0_READY; 53=OPAMP1_READY; 96=USART0_XCK; 97=USART1_XCK; 98=USART2_XCK; 104=SPI0_SCK; 105=SPI1_SCK; 128=TCA0_OVF_LUNF (Timer/Counter A0 overflow / low byte timer underflow); 129=TCA0_HUNF (Timer/Counter A0 high byte timer underflow); 132=TCA0_CMP0_LCMP0 (Timer/Counter A0 compare 0 / low byte timer compare 0); 133=TCA0_CMP1_LCMP1 (Timer/Counter A0 compare 1 / low byte timer compare 1); 134=TCA0_CMP2_LCMP2 (Timer/Counter A0 compare 2 / low byte timer compare 2); 160=TCB0_CAPT (Timer/Counter B0 capture); 161=TCB0_OVF (Timer/Counter B0 overflow); 162=TCB1_CAPT (Timer/Counter B1 capture); 163=TCB1_OVF (Timer/Counter B1 overflow); 164=TCB2_CAPT (Timer/Counter B2 capture); 165=TCB2_OVF (Timer/Counter B2 overflow); 176=TCD0_CMPBCLR (Timer/Counter D0 event 0); 177=TCD0_CMPASET (Timer/Counter D0 event 1); 178=TCD0_CMPBSET (Timer/Counter D0 event 2); 179=TCD0_PROGEV (Timer/Counter D0 event 3)
{0x20+2i} USERCCLLUT{i}A (i=0..3) — User {2i} - CCL{i} Event A
  [7:0] USER — User channel select
    0=OFF; {v}=CHANNEL{v-1} (Connect user to event channel {v-1}) (v=1..8)
{0x21+2i} USERCCLLUT{i}B (i=0..3) — User {2i+1} - CCL{i} Event B
  fields as USERCCLLUT0A
0x2C USERADC0START — User 12 - ADC0
  fields as USERCCLLUT0A
0x2D USEREVSYSEVOUTA — User 13 - EVOUTA
  fields as USERCCLLUT0A
0x2F USEREVSYSEVOUTC — User 15 - EVOUTC
  fields as USERCCLLUT0A
0x30 USEREVSYSEVOUTD — User 16 - EVOUTD
  fields as USERCCLLUT0A
0x32 USEREVSYSEVOUTF — User 18 - EVOUTF
  fields as USERCCLLUT0A
{0x34+i} USERUSART{i}IRDA (i=0..2) — User {i+20} - USART{i}
  fields as USERCCLLUT0A
0x3A USERTCA0CNTA — User 26 - TCA0 Event A
  fields as USERCCLLUT0A
0x3B USERTCA0CNTB — User 27 - TCA0 Event B
  fields as USERCCLLUT0A
{0x3E+2i} USERTCB{i}CAPT (i=0..2) — User {2i+30} - TCB{i} Event A
  fields as USERCCLLUT0A
{0x3F+2i} USERTCB{i}COUNT (i=0..2) — User {2i+31} - TCB{i} Event B
  fields as USERCCLLUT0A
0x48 USERTCD0INPUTA — User 40 - TCD0 Event A
  fields as USERCCLLUT0A
0x49 USERTCD0INPUTB — User 41 - TCD0 Event B
  fields as USERCCLLUT0A
0x4A USEROPAMP0ENABLE — User 42 - OPAMP0 Enable
  fields as USERCCLLUT0A
0x4B USEROPAMP0DISABLE — User 43 - OPAMP0 Disable
  fields as USERCCLLUT0A
0x4C USEROPAMP0DUMP — User 44 - OPAMP0 Dump
  fields as USERCCLLUT0A
0x4D USEROPAMP0DRIVE — User 45 - OPAMP0 Drive
  fields as USERCCLLUT0A
0x4E USEROPAMP1ENABLE — User 46 - OPAMP1 Enable
  fields as USERCCLLUT0A
0x4F USEROPAMP1DISABLE — User 47 - OPAMP1 Disable
  fields as USERCCLLUT0A
0x50 USEROPAMP1DUMP — User 48 - OPAMP1 Dump
  fields as USERCCLLUT0A
0x51 USEROPAMP1DRIVE — User 49 - OPAMP1 Drive
  fields as USERCCLLUT0A
