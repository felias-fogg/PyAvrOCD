# AVR32SD32 register map
Vendor: Atmel; File version: 1.0
CPU: other r0p0, little endian, no MPU, no FPU, 4 interrupt priority bits
Registers are 8-bit, read-write, reset 0x0 unless marked. A register's access mark holds for its fields unless they carry their own. Offsets are from the block's base; lines under a group give offsets from that group; [hi:lo] are bit positions; {n}, {i} and the like mark numbered series; 'fields as' and 'values as' point back to an identical list; <NAME> marks a mode.

## Memory map
0x00800000 VPORTA size 0x4 — Virtual Ports
0x00800008 VPORTC size 0x4 — Virtual Ports
0x0080000C VPORTD size 0x4 — Virtual Ports
0x00800014 VPORTF size 0x4 — Virtual Ports
0x0080001C GPR size 0x4 — General Purpose Registers
0x00800030 CPU blocks up to offset 0x10
0x00800040 RSTCTRL size 0x4 — Reset controller
0x00800050 SLPCTRL size 0x5 — Sleep Controller
0x00800060 BOD blocks up to offset 0xC — Bod interface
0x00800072 VREF blocks up to offset 0x3 — Voltage Reference
0x00800080 CLKCTRL blocks up to offset 0x59 — Clock controller
0x00800100 MVIO size 0x3 — Multi-Voltage I/O
0x00800110 WDT blocks up to offset 0x6 — Watchdog Timer
0x00800120 CPUINT size 0x4 — Interrupt Controller
0x00800130 CRCSCAN blocks up to offset 0xC
0x00800140 RTC blocks up to offset 0x17 — Real-Time Counter
0x008001C0 CCL blocks up to offset 0x20 — Configurable Custom Logic
0x00800200 EVSYS blocks up to offset 0x45 — Event System
0x00800400 PORTA blocks up to offset 0x19 — I/O Ports
0x00800440 PORTC blocks up to offset 0x19 — I/O Ports
0x00800460 PORTD blocks up to offset 0x19 — I/O Ports
0x008004A0 PORTF blocks up to offset 0x19 — I/O Ports
0x008005E0 PORTMUX blocks up to offset 0xE — Port Multiplexer
0x00800600 ADC0 size 0x15 — Analog to Digital Converter
0x00800640 ADC1 size 0x15 — Analog to Digital Converter
0x00800680 AC0 blocks up to offset 0x8 — Analog Comparator
0x00800688 AC1 blocks up to offset 0x8 — Analog Comparator
0x00800690 AC2 blocks up to offset 0x8 — Analog Comparator
0x008006A0 DAC0 blocks up to offset 0x4 — Digital to Analog Converter
0x008006C0 ZCD0 blocks up to offset 0x4 — Zero Cross Detect
0x008006D8 ZCD3 blocks up to offset 0x4 — Zero Cross Detect
0x00800800 USART0 size 0xF — Universal Synchronous and Asynchronous Receiver and Transmitter
0x00800820 USART1 size 0xF — Universal Synchronous and Asynchronous Receiver and Transmitter
0x00800840 USART2 size 0xF — Universal Synchronous and Asynchronous Receiver and Transmitter
0x00800900 TWI0 size 0xF — Two-Wire Interface
0x00800920 TWI1 size 0xF — Two-Wire Interface
0x00800940 SPI0 size 0x5 — Serial Peripheral Interface
0x00800960 SPI1 size 0x5 — Serial Peripheral Interface
0x00800A00 TCA0 blocks up to offset 0x3E — 16-bit Timer/Counter Type A
0x00800B00 TCB0 blocks up to offset 0xE — 16-bit Timer Type B
0x00800B10 TCB1 blocks up to offset 0xE — 16-bit Timer Type B
0x00800B20 TCB2 blocks up to offset 0xE — 16-bit Timer Type B
0x00800B30 TCB3 blocks up to offset 0xE — 16-bit Timer Type B
0x00800B80 TCD0 blocks up to offset 0x30 — Timer Counter D
0x00800E20 SWDT size 0xF — Synchronous Watchdog Timer
0x00800E30 RAMCTRL size 0x5 — RAM Controller
0x00800E40 ERRCTRL blocks up to offset 0x38 — Error Controller
0x00800F01 SYSCFG size 0x1 — System Configuration Registers
0x00801000 NVMCTRL size 0x12 — Non-volatile Memory Controller
0x00801040 LOCK size 0x4 — Lockbits
0x00801080 SIGROW blocks up to offset 0x20 — Signature row
0x00801100 BOOTROW size 0x1
0x00801200 USERROW size 0x1

## Interrupts
1 CPU CRCSCAN ERRCTRL_NMI (CPU)
2 BOD_VLM (CPU)
3 ERRCTRL_INT (CPU)
4 CLKCTRL_INT (CPU)
5 SLPCTRL_INT (CPU)
6 SWDT_INT (CPU)
7 NVMCTRL_ERROR (CPU)
8 RAMCTRL_INT (CPU)
9 CRCSCAN_INT (CPU)
10 MVIO_MVIO (CPU)
11 RTC_CNT (CPU)
12 RTC_PIT (CPU)
13 CCL_CCL (CPU)
14 PORTA_PORT (CPU)
15 TCA0_OVF (CPU)
16 TCA0_HUNF (CPU)
17 TCA0_CMP0 (CPU)
18 TCA0_CMP1 (CPU)
19 TCA0_CMP2 (CPU)
20 TCB0_INT (CPU)
21 TCB1_INT (CPU)
22 TCD0_OVF (CPU)
23 TCD0_TRIG (CPU)
24 TWI0_TWIS (CPU)
25 TWI0_TWIM (CPU)
26 SPI0_INT (CPU)
27 SPI1_INT (CPU)
28 USART0_RXC (CPU)
29 USART0_DRE (CPU)
30 USART0_TXC (CPU)
31 PORTD_PORT (CPU)
32 AC0_AC (CPU)
33 AC1_AC (CPU)
34 AC2_AC (CPU)
35 ADC0_ERROR (CPU)
36 ADC0_RESRDY (CPU)
37 ADC0_SAMPRDY (CPU)
38 ADC1_ERROR (CPU)
39 ADC1_RESRDY (CPU)
40 ADC1_SAMPRDY (CPU)
41 ZCD3_ZCD (CPU)
42 PORTC_PORT (CPU)
43 USART1_RXC (CPU)
44 USART1_DRE (CPU)
45 USART1_TXC (CPU)
46 PORTF_PORT (CPU)
47 NVMCTRL_READY (CPU)
48 TCB2_INT (CPU)
49 TCB3_INT (CPU)
50 ZCD0_ZCD (CPU)
51 USART2_RXC (CPU)
52 USART2_DRE (CPU)
53 USART2_TXC (CPU)
54 TWI1_TWIS (CPU)
55 TWI1_TWIM (CPU)
