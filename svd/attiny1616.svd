# ATtiny1616 register map
Vendor: Atmel; File version: 1.0
CPU: other r0p0, little endian, no MPU, no FPU, 4 interrupt priority bits
Registers are 8-bit, read-write, reset 0x0 unless marked. A register's access mark holds for its fields unless they carry their own. Offsets are from the block's base; [hi:lo] are bit positions; {n}, {i} and the like mark numbered series; 'fields as' and 'values as' point back to an identical list.

## EVSYS — Event System
Base 0x00800180
0x00 ASYNCSTROBE wo — Asynchronous Channel Strobe
0x01 SYNCSTROBE wo — Synchronous Channel Strobe
0x02 ASYNCCH0 — Asynchronous Channel 0 Generator Selection
  [7:0] ASYNCCH0
    0=OFF; 1=CCL_LUT0 (Configurable Custom Logic LUT0); 2=CCL_LUT1 (Configurable Custom Logic LUT1); 3=AC0_OUT (Analog Comparator 0 out); 4=TCD0_CMPBCLR (Timer/Counter D0 compare B clear); 5=TCD0_CMPASET (Timer/Counter D0 compare A set); 6=TCD0_CMPBSET (Timer/Counter D0 compare B set); 7=TCD0_PROGEV (Timer/Counter D0 program event); 8=RTC_OVF (Real Time Counter overflow); 9=RTC_CMP (Real Time Counter compare); {v}=PORTA_PIN{v-10} (Asynchronous Event from Pin PA{v-10}) (v=10..17); 18=UPDI (Unified Program and debug interface); 19=AC1_OUT (Analog Comparator 1 out); 20=AC2_OUT (Analog Comparator 2 out)
0x03 ASYNCCH1 — Asynchronous Channel 1 Generator Selection
  [7:0] ASYNCCH1
    0=OFF; 1=CCL_LUT0 (Configurable custom logic LUT0); 2=CCL_LUT1 (Configurable custom logic LUT1); 3=AC0_OUT (Analog Comparator 0 out); 4=TCD0_CMPBCLR (Timer/Counter D0 compare B clear); 5=TCD0_CMPASET (Timer/Counter D0 compare A set); 6=TCD0_CMPBSET (Timer/Counter D0 compare B set); 7=TCD0_PROGEV (Timer/Counter D0 program event); 8=RTC_OVF (Real Time Counter overflow); 9=RTC_CMP (Real Time Counter compare); {v}=PORTB_PIN{v-10} (Asynchronous Event from Pin PB{v-10}) (v=10..17); 18=AC1_OUT (Analog Comparator 1 out); 19=AC2_OUT (Analog Comparator 2 out)
0x04 ASYNCCH2 — Asynchronous Channel 2 Generator Selection
  [7:0] ASYNCCH2
    0=OFF; 1=CCL_LUT0 (Configurable Custom Logic LUT0); 2=CCL_LUT1 (Configurable Custom Logic LUT1); 3=AC0_OUT (Analog Comparator 0 out); 4=TCD0_CMPBCLR (Timer/Counter D0 compare B clear); 5=TCD0_CMPASET (Timer/Counter D0 compare A set); 6=TCD0_CMPBSET (Timer/Counter D0 compare B set); 7=TCD0_PROGEV (Timer/Counter D0 program event); 8=RTC_OVF (Real Time Counter overflow); 9=RTC_CMP (Real Time Counter compare); {v}=PORTC_PIN{v-10} (Asynchronous Event from Pin PC{v-10}) (v=10..15); 16=AC1_OUT (Analog Comparator 1 out); 17=AC2_OUT (Analog Comparator 2 out)
0x05 ASYNCCH3 — Asynchronous Channel 3 Generator Selection
  [7:0] ASYNCCH3
    0=OFF; 1=CCL_LUT0 (Configurable custom logic LUT0); 2=CCL_LUT1 (Configurable custom logic LUT1); 3=AC0_OUT (Analog Comparator 0 out); 4=TCD0_CMPBCLR (Timer/Counter type D compare B clear); 5=TCD0_CMPASET (Timer/Counter type D compare A set); 6=TCD0_CMPBSET (Timer/Counter type D compare B set); 7=TCD0_PROGEV (Timer/Counter type D program event); 8=RTC_OVF (Real Time Counter overflow); 9=RTC_CMP (Real Time Counter compare); 10=PIT_DIV8192 (Periodic Interrupt CLK_RTC div 8192); 11=PIT_DIV4096 (Periodic Interrupt CLK_RTC div 4096); 12=PIT_DIV2048 (Periodic Interrupt CLK_RTC div 2048); 13=PIT_DIV1024 (Periodic Interrupt CLK_RTC div 1024); 14=PIT_DIV512 (Periodic Interrupt CLK_RTC div 512); 15=PIT_DIV256 (Periodic Interrupt CLK_RTC div 256); 16=PIT_DIV128 (Periodic Interrupt CLK_RTC div 128); 17=PIT_DIV64 (Periodic Interrupt CLK_RTC div 64); 18=AC1_OUT (Analog Comparator 1 out); 19=AC2_OUT (Analog Comparator 2 out)
0x0A SYNCCH0 — Synchronous Channel 0 Generator Selection
  [7:0] SYNCCH0
    0=OFF; 1=TCB0 (Timer/Counter B0); 2=TCA0_OVF_LUNF (Timer/Counter A0 overflow); 3=TCA0_HUNF (Timer/Counter A0 underflow high byte (split mode)); 4=TCA0_CMP0 (Timer/Counter A0 compare 0); 5=TCA0_CMP1 (Timer/Counter A0 compare 1); 6=TCA0_CMP2 (Timer/Counter A0 compare 2); {v}=PORTC_PIN{v-7} (Synchronous Event from Pin PC{v-7}) (v=7..12); {v}=PORTA_PIN{v-13} (Synchronous Event from Pin PA{v-13}) (v=13..20); 21=TCB1 (Timer/Counter B1)
0x0B SYNCCH1 — Synchronous Channel 1 Generator Selection
  [7:0] SYNCCH1
    0=OFF; 1=TCB0 (Timer/Counter B0); 2=TCA0_OVF_LUNF (Timer/Counter A0 overflow); 3=TCA0_HUNF (Timer/Counter A0 underflow high byte (split mode)); 4=TCA0_CMP0 (Timer/Counter A0 compare 0); 5=TCA0_CMP1 (Timer/Counter A0 compare 1); 6=TCA0_CMP2 (Timer/Counter A0 compare 2); {v}=PORTB_PIN{v-8} (Synchronous Event from Pin PB{v-8}) (v=8..15); 16=TCB1 (Timer/Counter B1)
0x12 ASYNCUSER0 — Asynchronous User Ch 0 Input Selection - TCB0
  [7:0] ASYNCUSER0
    0=OFF; 1=SYNCCH0 (Synchronous Event Channel 0); 2=SYNCCH1 (Synchronous Event Channel 1); {v}=ASYNCCH{v-3} (Asynchronous Event Channel {v-3}) (v=3..6)
0x13 ASYNCUSER1 — Asynchronous User Ch 1 Input Selection - ADC0
  [7:0] ASYNCUSER1
    values as ASYNCUSER0.ASYNCUSER0
0x14 ASYNCUSER2 — Asynchronous User Ch 2 Input Selection - CCL LUT0 Event 0
  [7:0] ASYNCUSER2
    values as ASYNCUSER0.ASYNCUSER0
0x15 ASYNCUSER3 — Asynchronous User Ch 3 Input Selection - CCL LUT1 Event 0
  [7:0] ASYNCUSER3
    values as ASYNCUSER0.ASYNCUSER0
0x16 ASYNCUSER4 — Asynchronous User Ch 4 Input Selection - CCL LUT0 Event 1
  [7:0] ASYNCUSER4
    values as ASYNCUSER0.ASYNCUSER0
0x17 ASYNCUSER5 — Asynchronous User Ch 5 Input Selection - CCL LUT1 Event 1
  [7:0] ASYNCUSER5
    values as ASYNCUSER0.ASYNCUSER0
0x18 ASYNCUSER6 — Asynchronous User Ch 6 Input Selection - TCD0 Event 0
  [7:0] ASYNCUSER6
    values as ASYNCUSER0.ASYNCUSER0
0x19 ASYNCUSER7 — Asynchronous User Ch 7 Input Selection - TCD0 Event 1
  [7:0] ASYNCUSER7
    values as ASYNCUSER0.ASYNCUSER0
{0x12+i} ASYNCUSER{i} (i=8..10) — Asynchronous User Ch {i} Input Selection - Event Out {i-8}
  [7:0] ASYNCUSER{i}
    values as ASYNCUSER0.ASYNCUSER0
0x1D ASYNCUSER11 — Asynchronous User Ch 11 Input Selection - TCB1
  [7:0] ASYNCUSER11
    values as ASYNCUSER0.ASYNCUSER0
0x1E ASYNCUSER12 — Asynchronous User Ch 12 Input Selection - ADC1
  [7:0] ASYNCUSER12 — Asynchronous User Ch 12 Input Selection - ADC0
    values as ASYNCUSER0.ASYNCUSER0
0x22 SYNCUSER0 — Synchronous User Ch 0 - TCA0
  [7:0] SYNCUSER0
    0=OFF; 1=SYNCCH0 (Synchronous Event Channel 0); 2=SYNCCH1 (Synchronous Event Channel 1)
0x23 SYNCUSER1 — Synchronous User Ch 1 - USART0
  [7:0] SYNCUSER1
    values as SYNCUSER0.SYNCUSER0
